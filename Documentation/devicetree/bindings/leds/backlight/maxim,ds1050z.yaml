## Documentation/devicetree/bindings/leds/backlight/maxim,ds1050z.yaml
```yaml
# SPDX-License-Identifier: (GPL-2.0 OR BSD-2-Clause)
%YAML 1.2
---
$id: http://devicetree.org/schemas/leds/backlight/maxim,ds1050z.yaml#
$schema: http://devicetree.org/meta-schemas/core.yaml#

title: Maxim DS1050Z Backlight

maintainers:
  - Natalia Kovalenko <natasha.k@variscite.com>

description: |
  The DS1050 is a programmable 5-bit pulse-width modulator
  with an addressable 2-wire (I2C) control interface.

properties:
  compatible:
    const: maxim,ds1050z

  reg:
    maxItems: 1
    description: I2C address of the device.

  default-brightness:
    description: |
      Default brightness to apply at startup.
      Valid range: from 0 to 32.
    $ref: /schemas/types.yaml#/definitions/uint32

required:
  - compatible
  - reg

additionalProperties: false

examples:
  - |
    i2c {
        #address-cells = <1>;
        #size-cells = <0>;

        backlight: backlight@2c {
            compatible = "maxim,ds1050z";
            reg = <0x2c>;
            default-brightness = <22>;
            status = "okay";
        };
    };
```

## Documentation/devicetree/bindings/tpm/tcg,tpm-tis-i2c.yaml
```yaml
# SPDX-License-Identifier: (GPL-2.0-only OR BSD-2-Clause)
%YAML 1.2
---
$id: http://devicetree.org/schemas/tpm/tcg,tpm-tis-i2c.yaml#
$schema: http://devicetree.org/meta-schemas/core.yaml#

title: I²C-attached Trusted Platform Module conforming to TCG TIS specification

maintainers:
  - Lukas Wunner <lukas@wunner.de>

description: |
  The Trusted Computing Group (TCG) has defined a multi-vendor standard
  for accessing a TPM chip.  It can be transported over various buses,
  one of them being I²C.  The standard is named:
  TCG PC Client Specific TPM Interface Specification (TIS)
  https://trustedcomputinggroup.org/resource/pc-client-work-group-pc-client-specific-tpm-interface-specification-tis/

  The I²C interface was not originally part of the standard, but added
  in 2017 with a separate document:
  TCG PC Client Platform TPM Profile Specification for TPM 2.0 (PTP)
  https://trustedcomputinggroup.org/resource/pc-client-platform-tpm-profile-ptp-specification/

  Recent TPM 2.0 chips conform to this generic interface, others use a
  vendor-specific I²C interface.

properties:
  compatible:
    oneOf:
      - description: Generic TPM 2.0 chips conforming to TCG PTP interface
        items:
          - enum:
              - infineon,slb9673
              - nuvoton,npct75x
              - st,st33ktpm2xi2c
          - const: tcg,tpm-tis-i2c

      - description: TPM 1.2 and 2.0 chips with vendor-specific I²C interface
        items:
          - enum:
              - atmel,at97sc3204t # TPM 1.2
              - infineon,slb9635tt # TPM 1.2 (maximum 100 kHz)
              - infineon,slb9645tt # TPM 1.2 (maximum 400 kHz)
              - infineon,tpm_i2c_infineon # TPM 1.2
              - nuvoton,npct501 # TPM 1.2
              - nuvoton,npct601 # TPM 2.0
              - st,st33zp24-i2c # TPM 2.0
              - winbond,wpct301 # TPM 1.2

  reg:
    description: address of TPM on the I²C bus

allOf:
  - $ref: tpm-common.yaml#
  - if:
      properties:
        compatible:
          contains:
            const: tcg,tpm-tis-i2c
    then:
      properties:
        reset-duration-us:
          description:
            Minimum time in microseconds to hold reset asserted before
            releasing it. Presence requests a fresh reset during probe,
            which may discard TPM state and measurements made by firmware.
            Omit this property when a fresh reset is not required. The reset
            provider may still assert reset when the control is acquired.
            Select the duration according to the TPM and board requirements.
          minimum: 1
          maximum: 1000000

        reset-post-deassert-us:
          description:
            Minimum time in microseconds to wait after releasing reset before
            accessing the TPM. This delay does not request a fresh reset.
            Select the delay according to the TPM and board requirements.
            No additional delay is applied when this property is omitted.
          maximum: 1000000
          default: 0
      dependentSchemas:
        reset-duration-us:
          anyOf:
            - required: [resets]
            - required: [reset-gpios]
        reset-post-deassert-us:
          anyOf:
            - required: [resets]
            - required: [reset-gpios]

required:
  - compatible
  - reg

unevaluatedProperties: false

examples:
  - |
    #include <dt-bindings/gpio/gpio.h>
    i2c {
        #address-cells = <1>;
        #size-cells = <0>;

        tpm@2e {
            compatible = "st,st33ktpm2xi2c", "tcg,tpm-tis-i2c";
            reg = <0x2e>;
            reset-gpios = <&gpio1 0 GPIO_ACTIVE_LOW>;
            reset-duration-us = <1000>;
            reset-post-deassert-us = <50000>;
        };
    };

  - |
    i2c {
        #address-cells = <1>;
        #size-cells = <0>;

        tpm@57 {
            label = "tpm";
            compatible = "nuvoton,npct601";
            reg = <0x57>;
            linux,sml-base = <0x7f 0xfd450000>;
            linux,sml-size = <0x10000>;
        };
    };

  - |
    #include <dt-bindings/gpio/gpio.h>
    #include <dt-bindings/interrupt-controller/irq.h>
    i2c {
        #address-cells = <1>;
        #size-cells = <0>;

        tpm@13 {
            reg = <0x13>;
            compatible = "st,st33zp24-i2c";
            interrupt-parent = <&gpio5>;
            interrupts = <7 IRQ_TYPE_LEVEL_HIGH>;
            lpcpd-gpios = <&gpio5 15 GPIO_ACTIVE_HIGH>;
        };
    };
```
