## Documentation/devicetree/bindings/extcon/extcon-ptn5150.txt
```
* PTN5150 CC (Configuration Channel) Logic device

PTN5150 is a small thin low power CC logic chip supporting the USB Type-C
connector application with CC control logic detection and indication functions.
It is interfaced to the host controller using an I2C interface.

Required properties:
- compatible: should be "nxp,ptn5150"
- reg: specifies the I2C slave address of the device
- int-gpio: should contain a phandle and GPIO specifier for the GPIO pin
	connected to the PTN5150's INTB pin.
- vbus-gpio: should contain a phandle and GPIO specifier for the GPIO pin which
	is used to control VBUS.
- pinctrl-names : a pinctrl state named "default" must be defined.
- pinctrl-0 : phandle referencing pin configuration of interrupt and vbus
	control.
- irq-is-id-quirk: The PTN5150 has an open drain output, ID, that is driven low when a
      UFP is attached. ID is pulled high by an external resistor when either
      1) no cable is attached or 2) a DFP is attached.

      For designs that do not connect the PTN5150 IRQ, this boolean allows
      using the ID output as an IRQ by triggering on falling and rising edges.

      A falling edge indicates a UFP is attached (e.g. flash drive). Change
      to host mode using usb_role_switch_set_role.

      A rising edge indicates the UFP is removed. Prepare for when a DFP
      is connected by changing to device mode using usb_role_switch_set_role.

      This is useful because it allows a single device tree to support
      the following:

      Variscite's Symphony board <= 1.4 connects the PTN5150 IRQ pin to
      a GPIO on the SoM. Starting in Symphony board >= 1.4a, to allow
      compatibility with all Variscite i.MX8 SoMs, PTN5150 ID pin is
      instead connected to the same GPIO on the SoM.

Example:
	ptn5150@1d {
		compatible = "nxp,ptn5150";
		reg = <0x1d>;
		int-gpio = <&msmgpio 78 GPIO_ACTIVE_HIGH>;
		vbus-gpio = <&msmgpio 148 GPIO_ACTIVE_HIGH>;
		pinctrl-names = "default";
		pinctrl-0 = <&ptn5150_default>;
		status = "okay";
	};
```

## Documentation/devicetree/bindings/extcon/extcon-ptn5150.yaml
```yaml
# SPDX-License-Identifier: GPL-2.0-only OR BSD-2-Clause
%YAML 1.2
---
$id: http://devicetree.org/schemas/extcon/extcon-ptn5150.yaml#
$schema: http://devicetree.org/meta-schemas/core.yaml#

title: PTN5150 CC (Configuration Channel) Logic device

maintainers:
  - Krzysztof Kozlowski <krzk@kernel.org>

description: |
  PTN5150 is a small thin low power CC logic chip supporting the USB Type-C
  connector application with CC control logic detection and indication
  functions.  It is interfaced to the host controller using an I2C interface.

properties:
  compatible:
    const: nxp,ptn5150

  int-gpios:
    maxItems: 1
    deprecated: true
    description:
      GPIO pin (input) connected to the PTN5150's INTB pin.
      Use "interrupts" instead.

  interrupts:
    maxItems: 1

  reg:
    maxItems: 1

  vbus-gpios:
    maxItems: 1
    description:
      GPIO pin (output) used to control VBUS. If skipped, no such control
      takes place.

  irq-is-id-quirk:
    description:
      The PTN5150 has an open drain output, ID, that is driven low when a
      UFP is attached. ID is pulled high by an external resistor when either
      1) no cable is attached or 2) a DFP is attached.

      For designs that do not connect the PTN5150 IRQ, this boolean allows
      using the ID output as an IRQ by triggering on falling and rising edges.

      A falling edge indicates a UFP is attached (e.g. flash drive). Change
      to host mode using usb_role_switch_set_role.

      A rising edge indicates the UFP is removed. Prepare for when a DFP
      is connected by changing to device mode using usb_role_switch_set_role.

      This is useful because it allows a single device tree to support
      the following:

      Variscite's Symphony board <= 1.4 connects the PTN5150 IRQ pin to
      a GPIO on the SoM. Starting in Symphony board >= 1.4a, to allow
      compatibility with all Variscite i.MX8 SoMs, PTN5150 ID pin is
      instead connected to the same GPIO on the SoM.

required:
  - compatible
  - interrupts
  - reg

additionalProperties: false

examples:
  - |
    #include <dt-bindings/gpio/gpio.h>
    #include <dt-bindings/interrupt-controller/irq.h>
    i2c {
        #address-cells = <1>;
        #size-cells = <0>;

        ptn5150@1d {
            compatible = "nxp,ptn5150";
            reg = <0x1d>;
            interrupt-parent = <&msmgpio>;
            interrupts = <78 IRQ_TYPE_LEVEL_HIGH>;
            vbus-gpios = <&msmgpio 148 GPIO_ACTIVE_HIGH>;
        };
    };
```

## Documentation/devicetree/bindings/iio/counter/ftm-quaddec.txt
```
FlexTimer Quadrature decoder counter

This driver exposes a simple counter for the quadrature decoder mode.

Required properties:
- compatible:		Must be "fsl,ftm-quaddec".
- reg:			Must be set to the memory region of the flextimer.
- clocks:		Must be set to the root clk of the FlexTimer device
- clock-name:		Must be set to "ipg"

Optional property:
- big-endian:		Access the device registers in big-endian mode.

Example:
		counter1: counter@30640000 {
			compatible = "fsl,ftm-quaddec";
			reg = <0x30640000 0x10000>;
			clocks = <&clks IMX7D_FLEXTIMER1_ROOT_CLK>;
			clock-names = "ipg";
			big-endian;
			status = "disabled";
		};
```

## Documentation/devicetree/bindings/net/mxl,8611.yaml
```yaml
# SPDX-License-Identifier: GPL-2.0+
%YAML 1.2
---
$id: http://devicetree.org/schemas/net/mxl,yaml.yaml#
$schema: http://devicetree.org/meta-schemas/core.yaml#

title: MaxLinear MXL8611x PHY

maintainers:
  - Nate Drude <nate.d@variscite.com>

description: |
  Bindings for MaxLinear mxl8611x PHYs

allOf:
  - $ref: ethernet-phy.yaml#

properties:
  mxl-8611x,led0_cfg:
    description: |
      Register value for COM_EXT_LED0_CFG
    default: 0x0610

  mxl-8611x,led1_cfg:
    description: |
      Register value for COM_EXT_LED1_CFG
    default: 0x0620

  mxl-8611x,led2_cfg:
    description: |
      Register value for COM_EXT_LED2_CFG
    default: 0x0640

examples:
  - |
    ethernet {
        #address-cells = <1>;
        #size-cells = <0>;

        phy-mode = "rgmii-id";

        ethernet-phy@0 {
            reg = <0>;

        mxl-8611x,led0_cfg = <(
          MXL8611X_LEDX_CFG_LINK_UP_RX_ACT_ON |
          MXL8611X_LEDX_CFG_LINK_UP_TX_ACT_ON |
          MXL8611X_LEDX_CFG_TRAFFIC_ACT_BLINK_IND
        )>;
        mxl-8611x,led1_cfg = <(
          MXL8611X_LEDX_CFG_LINK_UP_10MB_ON |
          MXL8611X_LEDX_CFG_LINK_UP_100MB_ON |
          MXL8611X_LEDX_CFG_LINK_UP_1GB_ON
        )>;
        };
    };
```

## Documentation/devicetree/bindings/sound/wlf,wm8904.yaml
```yaml
# SPDX-License-Identifier: GPL-2.0-only OR BSD-2-Clause
%YAML 1.2
---
$id: http://devicetree.org/schemas/sound/wlf,wm8904.yaml#
$schema: http://devicetree.org/meta-schemas/core.yaml#

title: Wolfson WM8904/WM8912 audio codecs

maintainers:
  - patches@opensource.cirrus.com

description: |
  Pins on the device (for linking into audio routes):
  IN1L, IN1R, IN2L, IN2R, IN3L, IN3R, HPOUTL, HPOUTR, LINEOUTL, LINEOUTR,
  MICBIAS

properties:
  compatible:
    enum:
      - wlf,wm8904
      - wlf,wm8912

  reg:
    maxItems: 1

  "#sound-dai-cells":
    const: 0

  clocks:
    maxItems: 1

  clock-names:
    const: mclk

  AVDD-supply: true
  CPVDD-supply: true
  DBVDD-supply: true
  DCVDD-supply: true
  MICVDD-supply: true

required:
  - compatible
  - reg
  - clocks
  - clock-names
  - AVDD-supply
  - CPVDD-supply
  - DBVDD-supply
  - DCVDD-supply
  - MICVDD-supply

Optional properties:

  - gpio-cfg: Default registers value for R121/122/123/124 (GPIO Control).
    The list must be 4 entries long. If absent, the registers are set to 0.
    If any entry has the value 0xffff, the related register won't be set.

  - mic-cfg: Default registers value for R6/R7 (Mic Bias Control).
    The list must be 2 entries long. If absent, the registers are set to 0.

  - num-drc-cfgs: Number of available DRC modes from drc-cfg-regs property

  - drc-cfg-regs: Default registers value for R40/41/42/43 (DRC)
    The list must be (4 x num-drc-cfgs) entries long.
    If absent or incomplete, DRC is disabled.

  - drc-cfg-names: List of strings for the available DRC modes.
    The list must be (num-drc-cfgs) entries long.
    If absent or incomplete, DRC is disabled.

  - num-retune-mobile-cfgs: Number of retune modes available from
    retune-mobile-cfg-regs property

  - retune-mobile-cfg-regs: Default registers value for R134/.../157 (EQ)
    The list must be (24 x num-retune-mobile-cfgs) entries long.
    If absent or incomplete, retune is disabled.

  - retune-mobile-cfg-names: List of strings for the available retune modes.
    The list must be (num-retune-mobile-cfgs) entries long.
    If absent or incomplete, retune is disabled.

  - retune-mobile-cfg-rates: List of rates for the available retune modes.
    The list must be (num-retune-mobile-cfgs) entries long.
    If absent or incomplete, retune is disabled.

allOf:
  - $ref: dai-common.yaml#

unevaluatedProperties: false

examples:
  - |
    i2c {
        #address-cells = <1>;
        #size-cells = <0>;

        codec@1a {
            compatible = "wlf,wm8904";
            reg = <0x1a>;
            clocks = <&pck0>;
            clock-names = "mclk";
            num-drc-cfgs = <5>;
            drc-cfg-names = "default", "peaklimiter", "tradition", "soft", "music";
            drc-cfg-regs =
                /* coded default: KNEE_IP = KNEE_OP = 0, HI_COMP = LO_COMP = 1  */
                <0x01af 0x3248 0x0000 0x0000>,
                /* coded default: KNEE_IP = -24, KNEE_OP = -6, HI_COMP = 1/4, LO_COMP = 1 */
                <0x04af 0x324b 0x0010 0x0408>,
                /* coded default: KNEE_IP = -42, KNEE_OP = -3, HI_COMP = 0, LO_COMP = 1 */
                <0x04af 0x324b 0x0028 0x0704>,
                /* coded default: KNEE_IP = -45, KNEE_OP = -9, HI_COMP = 1/8, LO_COMP = 1 */
                <0x04af 0x324b 0x0018 0x078c>,
                /* coded default: KNEE_IP = -30, KNEE_OP = -10.5, HI_COMP = 1/4, LO_COMP = 1 */
                <0x04af 0x324b 0x0010 0x050e>;
            gpio-cfg = <
                0x0018 /* GPIO1 => DMIC_CLK */
                0xffff /* GPIO2 => don't touch */
                0xffff /* GPIO3 => don't touch */
                0xffff /* GPIO4 => don't touch */
            >;
            AVDD-supply = <&reg_1p8v>;
            CPVDD-supply = <&reg_1p8v>;
            DBVDD-supply = <&reg_1p8v>;
            DCVDD-supply = <&reg_1p8v>;
            MICVDD-supply = <&reg_1p8v>;
        };
    };
```

## Documentation/devicetree/bindings/sound/wm8904.txt
```
WM8904 audio CODEC

This device supports I2C only.

Required properties:
  - compatible: "wlf,wm8904" or "wlf,wm8912"
  - reg: the I2C address of the device.
  - clock-names: "mclk"
  - clocks: reference to
    <Documentation/devicetree/bindings/clock/clock-bindings.txt>

Optional properties:

  - gpio-cfg: Default registers value for R121/122/123/124 (GPIO Control).
    The list must be 4 entries long. If absent, the registers are set to 0.
    If any entry has the value 0xffff, the related register won't be set.

  - mic-cfg: Default registers value for R6/R7 (Mic Bias Control).
    The list must be 2 entries long. If absent, the registers are set to 0.

  - num-drc-cfgs: Number of available DRC modes from drc-cfg-regs property

  - drc-cfg-regs: Default registers value for R40/41/42/43 (DRC)
    The list must be (4 x num-drc-cfgs) entries long.
    If absent or incomplete, DRC is disabled.

  - drc-cfg-names: List of strings for the available DRC modes.
    The list must be (num-drc-cfgs) entries long.
    If absent or incomplete, DRC is disabled.

  - num-retune-mobile-cfgs: Number of retune modes available from
    retune-mobile-cfg-regs property

  - retune-mobile-cfg-regs: Default registers value for R134/.../157 (EQ)
    The list must be (24 x num-retune-mobile-cfgs) entries long.
    If absent or incomplete, retune is disabled.

  - retune-mobile-cfg-names: List of strings for the available retune modes.
    The list must be (num-retune-mobile-cfgs) entries long.
    If absent or incomplete, retune is disabled.

  - retune-mobile-cfg-rates: List of rates for the available retune modes.
    The list must be (num-retune-mobile-cfgs) entries long.
    If absent or incomplete, retune is disabled.

Pins on the device (for linking into audio routes):

  * IN1L
  * IN1R
  * IN2L
  * IN2R
  * IN3L
  * IN3R
  * HPOUTL
  * HPOUTR
  * LINEOUTL
  * LINEOUTR
  * MICBIAS

Examples:

codec: wm8904@1a {
	compatible = "wlf,wm8904";
	reg = <0x1a>;
	clocks = <&pck0>;
	clock-names = "mclk";
	num-drc-cfgs = <5>;
	drc-cfg-names = "default", "peaklimiter", "tradition", "soft", "music";
	drc-cfg-regs =
			/* coded default: KNEE_IP = KNEE_OP = 0, HI_COMP = LO_COMP = 1  */
			<0x01af 0x3248 0x0000 0x0000>,
			/* coded default: KNEE_IP = -24, KNEE_OP = -6, HI_COMP = 1/4, LO_COMP = 1 */
			<0x04af 0x324b 0x0010 0x0408>,
			/* coded default: KNEE_IP = -42, KNEE_OP = -3, HI_COMP = 0, LO_COMP = 1 */
			<0x04af 0x324b 0x0028 0x0704>,
			/* coded default: KNEE_IP = -45, KNEE_OP = -9, HI_COMP = 1/8, LO_COMP = 1 */
			<0x04af 0x324b 0x0018 0x078c>,
			/* coded default: KNEE_IP = -30, KNEE_OP = -10.5, HI_COMP = 1/4, LO_COMP = 1 */
			<0x04af 0x324b 0x0010 0x050e>;
	gpio-cfg = <
		0x0018 /* GPIO1 => DMIC_CLK */
		0xffff /* GPIO2 => don't touch */
		0xffff /* GPIO3 => don't touch */
		0xffff /* GPIO4 => don't touch */
	>;
};
```
