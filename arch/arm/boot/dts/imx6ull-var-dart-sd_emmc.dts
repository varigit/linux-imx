/*
 * Copyright (C) 2015-2016 Variscite Ltd. - http://www.variscite.com
 *
 * This program is free software; you can redistribute it and/or modify
 * it under the terms of the GNU General Public License version 2 as
 * published by the Free Software Foundation.
 */
/* SDCARD & eMMC devices enabled NAND & Wi-FI disabled.*/
/* #define WIFI */
#define EMMC
/* #define  NAND */
#include "imx6ull-var-dart.dtsi"
