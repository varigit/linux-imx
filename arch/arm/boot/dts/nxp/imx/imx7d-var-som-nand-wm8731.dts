// SPDX-License-Identifier: GPL-2.0+ OR MIT
//
// Copyright (C) 2016-2024 Variscite Ltd.

/dts-v1/;

#include "imx7d-var-som.dtsi"
#include "imx7d-var-som-nand.dtsi"
#include "imx7d-var-som-wm8731.dtsi"
#include "imx7d-var-som-mx7customboard.dtsi"

/ {
	model = "Variscite VAR-SOM-MX7 with NAND flash & WM8731 on VAR-MX7CustomBoard";
};
