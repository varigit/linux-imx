/*
 * Copyright (C) 2015-2024 Variscite Ltd.
 *
 * This program is free software; you can redistribute it and/or modify
 * it under the terms of the GNU General Public License version 2 as
 * published by the Free Software Foundation.
 */

#include "imx6dl-var-som.dtsi"
#include "imx6qdl-var-symphony-misc.dtsi"

/ {
	model = "Variscite i.MX6 DL/Solo VAR-SOM-MX6 Symphony";
};
