/*
 * Copyright (C) 2015-2025 Variscite Ltd. - https://www.variscite.com
 *
 * This program is free software; you can redistribute it and/or modify
 * it under the terms of the GNU General Public License version 2 as
 * published by the Free Software Foundation.
 */

&brcmf {
	sdio,must-keep-power-in-suspend;
};
