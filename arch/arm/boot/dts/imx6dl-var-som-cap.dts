/*
 * Copyright (C) 2016 Variscite, Ltd. All Rights Reserved
 *
 * This program is free software; you can redistribute it and/or modify
 * it under the terms of the GNU General Public License version 2 as
 * published by the Free Software Foundation.
 */

#include "imx6dl-var-som.dtsi"
#include "imx6qdl-var-mx6cb-cdisplay.dtsi"
