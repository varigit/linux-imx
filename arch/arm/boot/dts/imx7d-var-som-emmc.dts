/*
 * Copyright (C) 2015 Freescale Semiconductor, Inc.
 * Copyright (C) 2016-2026 Variscite Ltd.
 *
 * This program is free software; you can redistribute it and/or modify
 * it under the terms of the GNU General Public License version 2 as
 * published by the Free Software Foundation.
 */
/dts-v1/;

#include "imx7d.dtsi"
#include "imx7d-var-som.dtsi"
#include "imx7d-var-som-emmc.dtsi"
