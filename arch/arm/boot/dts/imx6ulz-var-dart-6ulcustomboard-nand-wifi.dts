/*
 * Copyright (C) 2019 Variscite Ltd. - https://www.variscite.com
 *
 * This program is free software; you can redistribute it and/or modify
 * it under the terms of the GNU General Public License version 2 as
 * published by the Free Software Foundation.
 */

/dts-v1/;

#include "imx6ulz.dtsi"

#include "imx6ulz-var-dart.dtsi"
#include "imx6ul-imx6ull-var-dart-nand.dtsi"
#include "imx6ul-imx6ull-var-dart-wifi.dtsi"

#include "imx6ulz-var-dart-6ulcustomboard.dtsi"

/ {
	model = "Variscite DART-6UL with i.MX6ULZ, NAND flash & WiFi support on VAR-6ULCustomBoard";
	compatible = "variscite,imx6ul-var-dart", "fsl,imx6ulz";
};
