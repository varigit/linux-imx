/*
 * Copyright (C) 2015-2019 Variscite Ltd. - https://www.variscite.com
 *
 * This program is free software; you can redistribute it and/or modify
 * it under the terms of the GNU General Public License version 2 as
 * published by the Free Software Foundation.
 */

/dts-v1/;

#include "imx6ul.dtsi"

#include "imx6ul-var-dart.dtsi"
#include "imx6ul-imx6ull-var-dart-emmc.dtsi"
#include "imx6ul-imx6ull-var-dart-wifi.dtsi"

#include "imx6ul-var-dart-6ulcustomboard.dtsi"


/ {
	model = "Variscite DART-6UL with i.MX6UL, eMMC & WiFi support on VAR-6ULCustomBoard";
	compatible = "variscite,imx6ul-var-dart", "fsl,imx6ul";
};
