/*
 * Copyright (C) 2015-2019 Variscite Ltd. - https://www.variscite.com
 *
 * This program is free software; you can redistribute it and/or modify
 * it under the terms of the GNU General Public License version 2 as
 * published by the Free Software Foundation.
 */

#include "imx6ul-imx6ull-var-dart-6ulcustomboard.dtsi"

&iomuxc {
	pinctrl_rtc: rtcgrp {
		fsl,pins = <
			MX6UL_PAD_SNVS_TAMPER7__GPIO5_IO07	0x1b0b0 /* RTC alarm IRQ */
		>;
	};
};
