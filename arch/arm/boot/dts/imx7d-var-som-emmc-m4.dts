/*
 * Copyright (C) 2015 Freescale Semiconductor, Inc.
 * Copyright (C) 2017 Variscite Ltd.
 *
 * This program is free software; you can redistribute it and/or modify
 * it under the terms of the GNU General Public License version 2 as
 * published by the Free Software Foundation.
 */
#include "imx7d-var-som-emmc.dts"
#include "imx7d-var-som-m4.dtsi"
