/*
 * Copyright (C) 2019 Variscite Ltd. - https://www.variscite.com
 *
 * This program is free software; you can redistribute it and/or modify
 * it under the terms of the GNU General Public License version 2 as
 * published by the Free Software Foundation.
 */

/dts-v1/;

#include "imx6ull.dtsi"

#include "imx6ull-var-som.dtsi"
#include "imx6ul-imx6ull-var-som-nand.dtsi"
#include "imx6ul-imx6ull-var-som-wifi.dtsi"

#include "imx6ull-var-som-symphony-board.dtsi"

/ {
	model = "Variscite VAR-SOM-6UL with i.MX6ULL, NAND flash & WiFi support on Symphony-Board";
	compatible = "variscite,imx6ul-var-som", "fsl,imx6ull";
};
