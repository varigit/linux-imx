/*
 * Copyright 2017 NXP
 * Copyright 2018-2019 Variscite Ltd.
 *
 * This program is free software; you can redistribute it and/or
 * modify it under the terms of the GNU General Public License
 * as published by the Free Software Foundation; either version 2
 * of the License, or (at your option) any later version.
 *
 * This program is distributed in the hope that it will be useful,
 * but WITHOUT ANY WARRANTY; without even the implied warranty of
 * MERCHANTABILITY or FITNESS FOR A PARTICULAR PURPOSE.  See the
 * GNU General Public License for more details.
 */

#include "imx8m-var-dart-common.dtsi"
#include "imx8m-var-dart-emmc-wifi.dtsi"
#include "imx8m-var-dart-hdmi.dtsi"

/ {
	model = "Variscite DART-MX8M EMMC+WIFI+HDMI";
};

