// SPDX-License-Identifier: (GPL-2.0 OR MIT)
/*
 * Copyright 2017 NXP
 * Copyright 2018-2021 Variscite Ltd.
 */

#include "imx8mq-var-dart-dt8mcustomboard-hdmi.dtsi"

&gpio1 {
	pinctrl-names = "default";
	pinctrl-0 = <&pinctrl_hdmi>;

	hdmi_on_hog {
		gpio-hog;
		gpios = <5 0>;
		output-low;
		line-name = "hdmi_on";
	};
};
