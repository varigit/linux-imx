// SPDX-License-Identifier: (GPL-2.0+ OR MIT)
/*
 * Copyright 2019 NXP
 * Copyright 2020-2024 Variscite Ltd.
 */

#include "imx8mp-var-dart.dtsi"
#include "imx8mp-var-dart-dt8mcustomboard-legacy.dtsi"

/ {
	model = "Variscite DART-MX8M-PLUS v2.x on DT8MCustomBoard 1.x";
};
