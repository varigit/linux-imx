// SPDX-License-Identifier: (GPL-2.0+ OR MIT)
/*
 * Copyright 2026 Variscite Ltd.
 */

/dts-v1/;

#include "imx91-var-dart.dtsi"
#include "imx91-var-dart-dt8mcustomboard.dtsi"
#include "imx91-var-dart-wbe-sonata.dtsi"

/ {
	model = "Variscite DART-MX91 with 802.15.4 on Sonata-Board";
};
