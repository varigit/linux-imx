// SPDX-License-Identifier: (GPL-2.0+ OR MIT)
/*
 * Copyright 2024 Variscite Ltd.
 */

&iw612_pwrseq {
	status = "disabled";
};

/* WIFI */
&usdhc1 {
	/delete-property/ mmc-pwrseq;

	brcmf: bcrmf@1 {
		reg = <1>;
		compatible = "brcm,bcm4329-fmac";
	};
};
