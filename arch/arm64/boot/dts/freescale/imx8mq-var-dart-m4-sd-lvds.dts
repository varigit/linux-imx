// SPDX-License-Identifier: (GPL-2.0 OR MIT)
/*
 * Copyright 2017 NXP
 * Copyright 2018-2020 Variscite Ltd.
 */

#include "imx8mq-var-dart-sd-lvds.dts"
#include "imx8mq-var-dart-m4.dtsi"

/ {
	model = "Variscite DART-MX8M M4+SD+LVDS";
};
