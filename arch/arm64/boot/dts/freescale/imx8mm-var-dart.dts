// SPDX-License-Identifier: (GPL-2.0+ OR MIT)
/*
 * Copyright 2019 NXP
 * Copyright 2019-2024 Variscite Ltd.
 */

#include "imx8mm-var-dart.dtsi"

/ {
	model = "Variscite DART-MX8MM on DT8MCustomBoard";
};
