// SPDX-License-Identifier: (GPL-2.0+ OR MIT)
/*
 * Copyright 2019 NXP
 * Copyright 2025 Variscite Ltd.
 */

#include "imx8mm-var-dart-2.x-dt8mcustomboard.dts"
#include "imx8mm-var-dart-2.x-sonata.dtsi"

/ {
	model = "Variscite DART-MX8M-MINI on Sonata-Board";
};
