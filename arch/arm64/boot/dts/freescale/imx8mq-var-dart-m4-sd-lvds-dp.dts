// SPDX-License-Identifier: (GPL-2.0 OR MIT)
/*
 * Copyright 2017 NXP
 * Copyright 2018-2020 Variscite Ltd.
 */

#include "imx8mq-var-dart-common.dtsi"
#include "imx8mq-var-dart-sd.dtsi"
#include "imx8mq-var-dart-lvds-lcdif.dtsi"
#include "imx8mq-var-dart-dp.dtsi"
#include "imx8mq-var-dart-m4.dtsi"

/ {
	model = "Variscite DART-MX8M M4+SD+LVDS+DP";
};
