// SPDX-License-Identifier: (GPL-2.0+ OR MIT)
/*
 * Copyright 2019 NXP
 * Copyright 2019-2024 Variscite Ltd.
 */

#include "imx8mm-var-dart-m4.dtsi"

/ {
	model = "Variscite DART-MX8MM Cortex-M4 on DT8MCustomBoard";
};
