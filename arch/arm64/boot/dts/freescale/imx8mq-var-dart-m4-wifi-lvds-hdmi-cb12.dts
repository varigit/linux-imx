// SPDX-License-Identifier: (GPL-2.0 OR MIT)
/*
 * Copyright 2017 NXP
 * Copyright 2019-2020 Variscite Ltd.
 */

#include "imx8mq-var-dart-common.dtsi"
#include "imx8mq-var-dart-wifi.dtsi"
#include "imx8mq-var-dart-lvds-lcdif.dtsi"
#include "imx8mq-var-dart-hdmi.dtsi"
#include "imx8mq-var-dart-m4.dtsi"
#include "imx8mq-var-dart-cb12.dtsi"

/ {
	model = "Variscite DART-MX8M CB-1.2 M4+WIFI+LVDS+HDMI";
};
