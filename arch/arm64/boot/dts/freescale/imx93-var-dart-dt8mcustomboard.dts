// SPDX-License-Identifier: (GPL-2.0+ OR MIT)
/*
 * Copyright 2024 Variscite Ltd.
 */

/dts-v1/;

#include "imx93-var-dart.dtsi"
#include "imx93-var-dart-dt8mcustomboard.dtsi"

/ {
	model = "Variscite DART-MX93 on DT8MCustomBoard";
};
