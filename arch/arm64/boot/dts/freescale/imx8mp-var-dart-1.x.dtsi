// SPDX-License-Identifier: (GPL-2.0+ OR MIT)
/*
 * Device tree overlay to support the DART-MX8M-PLUS 1.x
 *
 * Copyright 2024 Variscite Ltd.
 */

/dts-v1/;

#include <dt-bindings/gpio/gpio.h>
#include "imx8mp-var-dart.dtsi"

&iw612_pwrseq {
	status = "disabled";
};

&reg_eqos_phy {
	gpio = <&gpio2 20 GPIO_ACTIVE_HIGH>;
};

/* WIFI */
&usdhc1 {
	mmc-pwrseq = <>;

	brcmf: bcrmf@1 {
		reg = <1>;
		compatible = "brcm,bcm4329-fmac";
		laird,regdomain = "US";
	};
};
