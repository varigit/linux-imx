// SPDX-License-Identifier: (GPL-2.0+ OR MIT)
/*
 * Copyright 2024 Variscite Ltd.
 */

#include "imx8mp-var-dart-1.x.dtsi"
#include "imx8mp-var-dart-dt8mcustomboard-legacy.dtsi"

/ {
	model = "Variscite DART-MX8M-PLUS v1.x on DT8MCustomBoard 1.x";
};
