// SPDX-License-Identifier: (GPL-2.0+ OR MIT)
/*
 * Copyright 2023 Variscite Ltd.
 */

/dts-v1/;

#include "imx93-var-som-1.x.dtsi"
#include "imx93-var-som-symphony.dtsi"

/ {
	model = "Variscite VAR-SOM-MX93 1.x on Symphony-Board";
};
