// SPDX-License-Identifier: (GPL-2.0+ OR MIT)
/*
 * Copyright 2019 NXP
 * Copyright 2025 Variscite Ltd.
 */

#include "imx8mp-var-dart-dt8mcustomboard.dts"
#include "imx8mp-var-dart-sonata.dtsi"

/ {
	model = "Variscite DART-MX8M-PLUS on Sonata-Board";
};
