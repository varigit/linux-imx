// SPDX-License-Identifier: (GPL-2.0+ OR MIT)
/*
 * Copyright 2018 NXP
 * Copyright 2019-2020 Variscite Ltd.
 */

#include "imx8mn-var-som-symphony.dts"

/ {
	model = "Variscite VAR-SOM-MX8M-NANO on Symphony-Board 1.4 and below";
};

&usbotg1 {
	/delete-property/ extcon;
};

