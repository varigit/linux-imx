// SPDX-License-Identifier: (GPL-2.0+ OR MIT)
/*
 * Copyright 2025 Variscite Ltd.
 */

/dts-v1/;

#include "imx93-var-dart-sonata.dts"
#include "imx93-var-dart-dt8mcustomboard-m33.dtsi"

/ {
	model = "Variscite DART-MX93 M33 on Sonata-Board";
};
