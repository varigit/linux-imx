// SPDX-License-Identifier: (GPL-2.0+ OR MIT)
/*
 * Copyright 2019 NXP
 * Copyright 2025 Variscite Ltd.
 */

#include "imx8mm-var-dart-dt8mcustomboard-m4.dts"
#include "imx8mm-var-dart-sonata.dtsi"

/ {
	model = "Variscite DART-MX8M-MINI M4 on Sonata-Board";
};
