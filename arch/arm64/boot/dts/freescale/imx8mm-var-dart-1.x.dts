// SPDX-License-Identifier: (GPL-2.0+ OR MIT)
/*
 * Device tree overlay to support the DART-MX8M-MINI 1.x
 *
 * Copyright 2026 Variscite Ltd.
 */

/dts-v1/;
/plugin/;

#include "imx8mm-pinfunc.h"

&iw612_pwrseq {
	status = "disabled";
};

/* WIFI */
&usdhc1 {
	#address-cells = <1>;
	#size-cells = <0>;
	mmc-pwrseq = <>;

	brcmf: wifi@1 {
		reg = <1>;
		compatible = "brcm,bcm4329-fmac";
		laird,regdomain = "US";
	};
};
