// SPDX-License-Identifier: (GPL-2.0+ OR MIT)
/*
 * Copyright 2020-2024 Variscite Ltd.
 */

#include "imx8mp-var-som-1.x.dtsi"
#include "imx8mp-var-som-symphony.dtsi"

/ {
	model = "Variscite VAR-SOM-MX8M-PLUS 1.x on Symphony-Board";
};
