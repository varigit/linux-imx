// SPDX-License-Identifier: (GPL-2.0+ OR MIT)
/*
 * Copyright 2023 Variscite Ltd.
 */

#include "imx93-var-som.dtsi"

&iw612_pwrseq {
    status = "disabled";
};

&usdhc3 {
    /delete-property/ mmc-pwrseq;

	brcmf: bcrmf@1 {
		reg = <1>;
		compatible = "brcm,bcm4329-fmac";
	};
};
