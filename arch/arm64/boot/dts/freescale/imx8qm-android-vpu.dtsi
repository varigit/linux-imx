// SPDX-License-Identifier: (GPL-2.0+ OR MIT)
/*
 * Copyright 2022 NXP
 * Copyright 2019-2022 Variscite Ltd.
 */
&vpu {
	compatible = "nxp,imx8qm-vpu";
	status = "okay";
};

&vpu_core0 {
	reg = <0x2d080000 0x10000>;
	memory-region = <&decoder_boot>, <&decoder_rpc>;
	status = "okay";
};

&vpu_core1 {
	reg = <0x2d090000 0x10000>;
	memory-region = <&encoder1_boot>, <&encoder1_rpc>;
	status = "okay";
};

&vpu_core2 {
	reg = <0x2d0a0000 0x10000>;
	memory-region = <&encoder2_boot>, <&encoder2_rpc>;
	status = "okay";
};
