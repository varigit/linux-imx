// SPDX-License-Identifier: (GPL-2.0 OR MIT)
/*
 * Copyright 2017 NXP
 * Copyright 2019-2021 Variscite Ltd.
 */

#include "imx8mq-var-dart-dt8mcustomboard.dtsi"
#include "imx8mq-var-dart-wifi.dtsi"
#include "imx8mq-var-dart-dt8mcustomboard-lvds-lcdif.dtsi"
#include "imx8mq-var-dart-dt8mcustomboard-hdmi.dtsi"
#include "imx8mq-var-dart-dt8mcustomboard-m4.dtsi"

/ {
	model = "Variscite DART-MX8M on DT8MCustomBoard 2.x and above, with M4+WIFI+LVDS+HDMI support";
};
