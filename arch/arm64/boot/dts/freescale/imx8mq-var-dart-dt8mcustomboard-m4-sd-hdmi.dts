// SPDX-License-Identifier: (GPL-2.0 OR MIT)
/*
 * Copyright 2017 NXP
 * Copyright 2018-2021 Variscite Ltd.
 */

#include "imx8mq-var-dart-dt8mcustomboard-sd-hdmi.dts"
#include "imx8mq-var-dart-dt8mcustomboard-m4.dtsi"

/ {
	model = "Variscite DART-MX8M on DT8MCustomBoard 2.x and above M4+SD+HDMI";
};
