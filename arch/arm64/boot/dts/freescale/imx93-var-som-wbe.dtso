// SPDX-License-Identifier: (GPL-2.0+ OR MIT)
/*
 * Device tree overlay to support the WiFi/BT chipset with 802.15.4
 *
 * Copyright (C) 2026 Variscite Ltd. - https://www.variscite.com/
 *
 */

/dts-v1/;
/plugin/;

&{/} {
	model = "Variscite VAR-SOM-MX93 2.x and newer with 802.15.4 on Symphony-Board";
};

&ads7846 {
	status = "disabled";
};

&lpspi8 {
	#address-cells = <1>;
	#size-cells = <0>;

	/* 802.15.4 SPI device */
	spidev@0 {
		pinctrl-names = "default";
		pinctrl-0 = <&pinctrl_restouch>;
		reg = <0>;
		compatible = "var,spidev";
		spi-max-frequency = <1000000>;
		status = "okay";
	};
};
