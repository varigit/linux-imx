// SPDX-License-Identifier: (GPL-2.0 OR MIT)
/*
 * Copyright 2017 NXP
 * Copyright 2018-2023 Variscite Ltd.
 */

#include "imx8mq-var-dart-dt8mcustomboard-legacy-wifi-lvds.dts"
#include "imx8mq-var-dart-dt8mcustomboard-m4.dtsi"

/ {
	model = "Variscite DART-MX8M on DT8MCustomBoard 1.x M4+WIFI+LVDS";
};
/ {
        chosen {
                bootargs-append = "androidboot.primary_display=imx-dcss androidboot.gui_resolution=1080p androidboot.fbTileSupport=enable androidboot.wifisdio=30b50000.mmc androidboot.btmmchost=mmc1";
        };
};
